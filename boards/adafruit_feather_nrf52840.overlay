/ {
	chosen {
		zmk,kscan = &kscan0;
	};

	kscan0: kscan_0 {
		compatible = "zmk,kscan-gpio-matrix";
		label  = "KSCAN";
		diode-direction = "col2row";

		col-gpios
			= <&gpio0 7 GPIO_ACTIVE_HIGH> 
			, <&gpio1 8 GPIO_ACTIVE_HIGH>
			, <&gpio0 11  GPIO_ACTIVE_HIGH>
			, <&gpio0 12 GPIO_ACTIVE_HIGH>
			, <&gpio0 5 GPIO_ACTIVE_HIGH>
			, <&gpio0 30 GPIO_ACTIVE_HIGH>
			, <&gpio0 28 GPIO_ACTIVE_HIGH>
			, <&gpio0 2 GPIO_ACTIVE_HIGH>
			, <&gpio0 3 GPIO_ACTIVE_HIGH>
			, <&gpio0 14 GPIO_ACTIVE_HIGH>
			, <&gpio0 13 GPIO_ACTIVE_HIGH>
			, <&gpio0 15 GPIO_ACTIVE_HIGH>
			;

			
		row-gpios
			= <&gpio0 26 (GPIO_ACTIVE_HIGH | GPIO_PULL_DOWN)>
			, <&gpio0 27 (GPIO_ACTIVE_HIGH | GPIO_PULL_DOWN)>
			, <&gpio0 6 (GPIO_ACTIVE_HIGH | GPIO_PULL_DOWN)>
			, <&gpio0 8 (GPIO_ACTIVE_HIGH | GPIO_PULL_DOWN)>
			;
	};

};

